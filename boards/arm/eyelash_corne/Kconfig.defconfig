## boards/arm/eyelash_corne/Kconfig.defconfig
```kconfig
#
# Copyright (c) 2024 The ZMK Contributors
# SPDX-License-Identifier: MIT
#

if BOARD_EYELASH_CORNE_LEFT

config ZMK_KEYBOARD_NAME
    default "Eyelash Corne"

config ZMK_SPLIT_ROLE_CENTRAL
    default y

endif # BOARD_EYELASH_CORNE_LEFT

if BOARD_EYELASH_CORNE_LEFT || BOARD_EYELASH_CORNE_RIGHT

config BOARD
    default "eyelash_corne"

config BOARD_ENABLE_DCDC
    bool "Enable DCDC mode"
    select SOC_DCDC_NRF52X
    default y

config BOARD_ENABLE_DCDC_HV
    bool "Enable High Voltage DCDC converter"
    default y
    select SOC_DCDC_NRF52X_HV
    depends on (BOARD_EYELASH_CORNE_LEFT || BOARD_EYELASH_CORNE_RIGHT)

config ZMK_SLEEP
    default y

config ZMK_SPLIT
    default y

config BT_CTLR
    default BT

if USB

config USB_NRFX
    default y

config USB_DEVICE_STACK
    default y

endif # USB

if ZMK_BACKLIGHT

config PWM
    default y

config LED_PWM
    default y

endif # ZMK_BACKLIGHT

endif # BOARD_EYELASH_CORNE_LEFT || BOARD_EYELASH_CORNE_RIGHT
```

## boards/shields/eyelash_corne/Kconfig.defconfig
```kconfig
#
# Copyright (c) 2024 The ZMK Contributors
# SPDX-License-Identifier: MIT
#

if SHIELD_EYELASH_CORNE_LEFT

config ZMK_KEYBOARD_NAME
    default "Eyelash Corne"

config ZMK_SPLIT_ROLE_CENTRAL
    default y

endif # SHIELD_EYELASH_CORNE_LEFT


if SHIELD_EYELASH_CORNE_LEFT || SHIELD_EYELASH_CORNE_RIGHT

config ZMK_SPLIT
    default y

config BT_CTLR
    default BT

if USB

config USB_NRFX
    default y

config USB_DEVICE_STACK
    default y

endif # USB

if ZMK_BACKLIGHT

config PWM
    default y

config LED_PWM
    default y

endif # ZMK_BACKLIGHT

endif # SHIELD_EYELASH_CORNE_LEFT || SHIELD_EYELASH_CORNE_RIGHT
```

## boards/shields/eyelash_corne/Kconfig.shield
```kconfig
# Copyright (c) 2020 The ZMK Contributors
# SPDX-License-Identifier: MIT

config SHIELD_EYELASH_CORNE_LEFT
    def_bool $(shields_list_contains,eyelash_corne_left)

config SHIELD_EYELASH_CORNE_RIGHT
    def_bool $(shields_list_contains,eyelash_corne_right)
```

## config/west.yml
```yaml
manifest:
  remotes:
    - name: zmkfirmware
      url-base: https://github.com/zmkfirmware
      # Additional modules containing boards/shields/custom code can be listed here as well.
      # See:
      # - https://zmk.dev/docs/features/modules
      # - https://docs.zephyrproject.org/3.5.0/develop/west/manifest.html#projects
  projects:
    - name: eyelash_corne
      url: https://github.com/a741725193/zmk-new_corne
      revision: main
    - name: zmk
      remote: zmkfirmware
      revision: v0.3
      import: app/west.yml
  self:
    path: config
```
