/*
*
* Copyright (c) 2024 The ZMK Contributors
* SPDX-License-Identifier: MIT
*
*/

#include "eyelash_corne.dtsi"

&default_transform {
    col-offset = <7>;
};

&i2c1 {
  status = "okay";
};

&tps43 {
  status = "okay";
};
